## base_external/package/aesd-assignments/Config.in
```kconfig
config BR2_PACKAGE_AESD_ASSIGNMENTS
    bool "aesd-assignments"
    help
      This package builds and installs the AESD assignment applications,
      including finder.sh, writer, tester.sh, and configuration files.
```
